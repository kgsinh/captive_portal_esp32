## test/sdkconfig.defaults
```kconfig
CONFIG_HTTPD_MAX_REQ_HDR_LEN=1024
CONFIG_LWIP_MAX_SOCKETS=16

# Disable watchdog timers for testing
CONFIG_ESP_TASK_WDT=n
CONFIG_ESP_INT_WDT=n

# Increase stack sizes for testing
CONFIG_ESP_MAIN_TASK_STACK_SIZE=8192
CONFIG_UNITY_FREERTOS_STACK_SIZE=8192

# Enable more verbose logging for debugging
CONFIG_LOG_DEFAULT_LEVEL_DEBUG=y
CONFIG_LOG_MAXIMUM_LEVEL_DEBUG=y
```
